## zephyr/Kconfig
```kconfig
config LUA
	bool "Lua scripting language"
	default n
	depends on POSIX_API
	depends on PICOLIBC || NEWLIB_LIBC
	depends on FILE_SYSTEM
	help
	  This option adds the lua library to the zephyr build.

config LUA_ROOT
	string "Root for lua files"
	default "/lfs/"
	depends on LUA
	help
		This option allows to change the root for the default path for lua files
		used with require (LUA_PATH_DEFAULT)
		Lua modules go in LUA_ROOT/lua/
		C lua modules go in LUA_ROOT/lib/lua/

config LUA_GLOCK
	bool "Global Interpreter Lock for the lua virtual machine"
	default n
	depends on LUA
	help
		This option includes a global interpreter lock for the lua virtual
		machine, that allows multithreaded access to the same lua state. You
		still must synchronize access to shared tables. Have a look to:
		http://lua-users.org/wiki/ThreadsTutorial

if LUA

# posible additional options, like for instance adding a shell command for a lua
# interpreter

endif
```
